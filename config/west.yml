## config/west.yml
```yaml
manifest:
  remotes:
    - name: zmkfirmware
      url-base: https://github.com/zmkfirmware
  projects:
    - name: zmk
      remote: zmkfirmware
      # This config repo still uses the pre-HWMv2 custom board layout.
      revision: v0.3
      import: app/west.yml
  self:
    path: config
```
